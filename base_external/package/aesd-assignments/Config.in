## base_external/package/aesd-assignments/Config.in
```kconfig
config BR2_PACKAGE_AESD_ASSIGNMENTS
	bool "aesd-assignments"
	depends on BR2_LINUX_KERNEL
	help
	  Includes the writer executable, finder.sh, tester.sh, aesdsocket and
	  the aesdchar kernel module in the image.
	  Used to understand buildroot external trees and package builds.
```
